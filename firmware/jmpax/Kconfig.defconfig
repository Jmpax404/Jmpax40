## firmware/jmpax/Kconfig.defconfig
```kconfig
# Copyright (c) 2023 The ZMK Contributors
# SPDX-License-Identifier: MIT

if SHIELD_JMPAX_LEFT

config ZMK_KEYBOARD_NAME
    default "Jmpax_Keyboard"

config ZMK_SPLIT_ROLE_CENTRAL
    default y

endif

if SHIELD_JMPAX_RIGHT

config ZMK_KEYBOARD_NAME
	default "Jmpax_kb_R"
	
endif

if SHIELD_JMPAX_LEFT || SHIELD_JMPAX_RIGHT

config ZMK_SPLIT
    default y

endif
```

## firmware/jmpax/Kconfig.shield
```kconfig
# Copyright (c) 2023 The ZMK Contributors
# SPDX-License-Identifier: MIT

config SHIELD_JMPAX_LEFT
    def_bool $(shields_list_contains,jmpax_left)

config SHIELD_JMPAX_RIGHT
    def_bool $(shields_list_contains,jmpax_right)
```
